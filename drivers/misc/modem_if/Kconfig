## drivers/misc/modem_if/Kconfig
```kconfig
menuconfig SEC_MODEM
	bool "Samsung Mobile Modem Interface"
	default n
	---help---
	  Samsung Modem Interface Driver.

comment "Modem chips"

config UMTS_MODEM_XMM6260
	bool "IMC XMM6260"
	depends on SEC_MODEM
	default n

config UMTS_MODEM_XMM6262
	bool "IMC XMM6262"
	depends on SEC_MODEM
	default n

config CDMA_MODEM_CBP71
	bool "VIA CBP7.1"
	depends on SEC_MODEM
	default n

config CDMA_MODEM_CBP72
	bool "VIA CBP7.2"
	depends on SEC_MODEM
	default n

config LTE_MODEM_CMC221
	bool "SEC CMC221"
	depends on SEC_MODEM
	default n

config CDMA_MODEM_MDM6600
	bool "QC MDM6600"
	depends on SEC_MODEM
	default n

config GSM_MODEM_ESC6270
	bool "QC ESC6270"
	depends on SEC_MODEM
	default n

comment "Modem link devices"

config LINK_DEVICE_MIPI
	bool "MIPI-HSI link"
	depends on SEC_MODEM
	default n

config LINK_DEVICE_DPRAM
	bool "DPRAM link"
	depends on SEC_MODEM
	default n

config LINK_DEVICE_PLD
	bool "PLD link"
	depends on SEC_MODEM
	default n

config LINK_DEVICE_USB
	bool "USB link"
	depends on SEC_MODEM
	default n

config LINK_DEVICE_HSIC
	bool "HSIC link"
	depends on SEC_MODEM
	default n

config LINK_DEVICE_C2C
	bool "C2C link"
	depends on SEC_MODEM
	default n

comment "IPC"

config IPC_CMC22x_OLD_RFS
	bool "IPC: CMC22x ancient RFS"
	depends on SEC_MODEM
	default n

config SIPC_VER_5
	bool "IPC: Samsung IPC 5.0"
	depends on SEC_MODEM
	default n

comment "etc"

config SIM_DETECT
	bool "SIM_DETECT pin"
	depends on SEC_MODEM
	default n

config SIM_SLOT_SWITCH
	bool "SIM_SLOT_SWITCH"
	depends on SEC_MODEM
	default n
```

## drivers/staging/android/ion/Kconfig
```kconfig
menuconfig ION_MAINLINE
	bool "Ion Memory Manager (Android common kernel version)"
	depends on HAVE_MEMBLOCK && !ION
	select GENERIC_ALLOCATOR
	select DMA_SHARED_BUFFER
	---help---
	  Chose this option to enable the ION Memory Manager,
	  used by Android to efficiently allocate buffers
	  from userspace that can be shared between drivers.
	  If you're not using Android its probably safe to
	  say N here.

config ION_MAINLINE_TEST
	tristate "Ion Test Device"
	depends on ION_MAINLINE
	help
	  Choose this option to create a device that can be used to test the
	  kernel and device side ION functions.

config ION_MAINLINE_TEGRA
	tristate "Ion for Tegra"
	depends on ARCH_TEGRA && ION_MAINLINE
	help
	  Choose this option if you wish to use ion on an nVidia Tegra.

config ION_POOL_CACHE_POLICY
	bool "Ion set page pool cache policy"
	depends on ION_MAINLINE
	default y if X86
	help
	  Choose this option if need to explicity set cache policy of the
	  pages in the page pool.
```

## drivers/staging/samsung/Kconfig
```kconfig
comment "Debugging Feature"
menuconfig SEC_DEBUG
    bool "Samsung TN Ramdump Feature"
    default y
    help
      Samsung TN Ramdump Feature. Use INFORM3 and magic number at 0xc0000000.

config SEC_LOG
	default n
	bool "Enable support for sec_log" if EMBEDDED
	depends on PRINTK
	help
	  This option enables sec_log support. This provides combined
	  log buffer for both bootloader and kernel. It also preserves
	  previous content before reboot.

config SEC_LOG_NONCACHED
	default n
	bool "Enable non cached kernel sec_log support" if EMBEDDED
	depends on SEC_LOG
	help
	  This option enables sec_non_cached_klog support.  It can
	  support non-cached kernel log in RAM dump and We don't need
	  to concern cache flush status for analyzing sudden lockup
	  issue.

config SEC_LOG_LAST_KMSG
	default n
	bool "Enable /proc/last_kmsg support" if EMBEDDED
	depends on SEC_LOG
	help
	  This option enables /proc/last_kmsg support.

config SEC_AVC_LOG
	default n
	bool "Enable avc audit log support" if EMBEDDED
	depends on SEC_LOG
	help
	  This option enables additional log buffer for audit log.

config SEC_DEBUG_TSP_LOG
	default n
	bool "Enable tsp log support" if EMBEDDED
	depends on SEC_LOG
	help
	  This option enables additional log buffer for tsp log.

config SEC_DEBUG_TIMA_LOG
	default y
	bool "Enable tima log support" if EMBEDDED
	depends on SEC_LOG
	help
	  This option enables additional log buffer for tima log.

config SEC_DEBUG_PMU_LOG
	default n
	bool "Enable pmu log support" if EMBEDDED
```
